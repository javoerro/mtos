## components/mtos/Kconfig
```kconfig
menu "MToS - Memory Transfer over Serial"

    config MTOS_UART_PORT
        int "UART port to use"
        default 2
        help
            Sets UART port for use in MToS

    config MTOS_UART_BAUD_RATE
        int "Comunication speed"
        default 115200
        help
            Baud rate


    config MTOS_UART_TX_PIN
        int "UART pin used for TX"
        default -1
        help
            Sets UART pin for TX

    config MTOS_UART_RX_PIN
        int "UART pin used for RX"
        default -1
        help
            Sets UART pin used for RX

    config MTOS_UART_STEP_MS
        int "Step time for data RX"
        default 10
        help
            Caracters will be waited this amount of time, in case exceeded, data parsing will start

    config MTOS_DEFAULT_TIMEOUT
        int "Default timeout for calls in master and slave"
        default 10000
        help
            Default timeout for calls in master and slave

    config MTOS_BUFFER_SIZE
        int "Comunication buffer"
        default 4096
        help
            Sets size of buffer for data exchange, affects the max chunk size. Not less than 64

    config MTOS_BUFFER_LEGACY
        int "Minimum buffer legacy between iterations"
        default 32
        help
            As the data is parsed, the buffer will be flushed leaving this remainder available for the next iteration.
            Not less than 32, not more than 128

    config MTOS_CALL_QUEUE_LENGTH
        int "Number of calls that can be queued"
        default 4
        help
            Length of call queue

    config MTOS_EVT_QUEUE_SIZE
        int "Number of events that can be queued"
        default 16
        help
            Length of event queue

endmenu
```

## sdkconfig.defaults
```kconfig
CONFIG_MTOS_UART_PORT=1
CONFIG_MTOS_UART_BAUD_RATE=921600
CONFIG_MTOS_UART_TX_PIN=4
CONFIG_MTOS_UART_RX_PIN=5
CONFIG_MTOS_UART_STEP_MS=10
CONFIG_MTOS_DEFAULT_TIMEOUT=10000
CONFIG_MTOS_BUFFER_SIZE=4096
CONFIG_MTOS_BUFFER_LEGACY=32
CONFIG_MTOS_CALL_QUEUE_LENGTH=4
CONFIG_MTOS_EVT_QUEUE_SIZE=16
```
